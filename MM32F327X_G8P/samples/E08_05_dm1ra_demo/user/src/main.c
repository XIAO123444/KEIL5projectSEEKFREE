/*********************************************************************************************************************
* MM32F327X-G8P Opensourec Library 即（MM32F327X-G8P 开源库）是一个基于官方 SDK 接口的第三方开源库
* Copyright (c) 2022 SEEKFREE 逐飞科技
* 
* 本文件是 MM32F327X-G8P 开源库的一部分
* 
* MM32F327X-G8P 开源库 是免费软件
* 您可以根据自由软件基金会发布的 GPL（GNU General Public License，即 GNU通用公共许可证）的条款
* 即 GPL 的第3版（即 GPL3.0）或（您选择的）任何后来的版本，重新发布和/或修改它
* 
* 本开源库的发布是希望它能发挥作用，但并未对其作任何的保证
* 甚至没有隐含的适销性或适合特定用途的保证
* 更多细节请参见 GPL
* 
* 您应该在收到本开源库的同时收到一份 GPL 的副本
* 如果没有，请参阅<https://www.gnu.org/licenses/>
* 
* 额外注明：
* 本开源库使用 GPL3.0 开源许可证协议 以上许可申明为译文版本
* 许可申明英文版在 libraries/doc 文件夹下的 GPL3_permission_statement.txt 文件中
* 许可证副本在 libraries 文件夹下 即该文件夹下的 LICENSE 文件
* 欢迎各位使用并传播本程序 但修改内容时必须保留逐飞科技的版权声明（即本声明）
* 
* 文件名称          main
* 公司名称          成都逐飞科技有限公司
* 版本信息          查看 libraries/doc 文件夹内 version 文件 版本说明
* 开发环境          IAR 8.32.4 or MDK 5.37
* 适用平台          MM32F327X_G8P
* 店铺链接          https://seekfree.taobao.com/
* 
* 修改记录
* 日期              作者                备注
* 2022-08-10        Teternal            first version
********************************************************************************************************************/

#include "zf_common_headfile.h"

// 打开新的工程或者工程移动了位置务必执行以下操作
// 第一步 关闭上面所有打开的文件
// 第二步 project->clean  等待下方进度条走完


// 本例程是 有来模块（无 MCU 版本 DM1RA） 的使用例程 本例程仅演示如何使用 DM1RA 进行测距信号接收并输出对应距离信息 必须要有另一个板子使用 有去模块（无 MCU 版本 DM1TA）例程配套测试
// 本例程是 有来模块（无 MCU 版本 DM1RA） 的使用例程 本例程仅演示如何使用 DM1RA 进行测距信号接收并输出对应距离信息 必须要有另一个板子使用 有去模块（无 MCU 版本 DM1TA）例程配套测试
// 本例程是 有来模块（无 MCU 版本 DM1RA） 的使用例程 本例程仅演示如何使用 DM1RA 进行测距信号接收并输出对应距离信息 必须要有另一个板子使用 有去模块（无 MCU 版本 DM1TA）例程配套测试


// *************************** 例程硬件连接说明 ***************************
// 使用逐飞科技 CMSIS-DAP | ARM 调试下载器连接
//      直接将下载器正确连接在核心板的调试下载接口即可
// 
// 使用 USB-TTL 模块连接
//      模块管脚            单片机管脚
//      USB-TTL-RX          查看 zf_common_debug.h 文件中 DEBUG_UART_TX_PIN 宏定义的引脚 默认 B6
//      USB-TTL-TX          查看 zf_common_debug.h 文件中 DEBUG_UART_RX_PIN 宏定义的引脚 默认 B7
//      USB-TTL-GND         核心板电源地 GND
//      USB-TTL-3V3         核心板 3V3 电源
// 
// 接入 DM1RA 模块
//      模块管脚            单片机管脚
//      S                   查看 zf_device_dm1xa.h 中 DM1XA_S_PIN  宏定义 默认 B11
//      L                   查看 zf_device_dm1xa.h 中 DM1XA_L_PIN  宏定义 默认 B10
//      VCC                 5V 电源
//      GND                 电源地


// *************************** 例程测试说明 ***************************
// 1.核心板烧录完成本例程
// 
// 2.在断电情况下，单独使用核心板与调试下载器或者 USB-TTL 模块连接，并连接好 DM1RA 模块
//      ( 如果使用配套的学习主板测试，则直接将 DM1RA 模块接到对应的接口位置 )
// 
// 3.使用 Type-C 给核心板供电，将调试下载器或者 USB-TTL 模块连接到电脑
//      ( 如果使用配套的学习主板测试，则需要直接使用电池供电，2S锂电池/蓝电池电压不应低于7.8V，3S锂电池电压不应低于11.3V )
// 
// 4.在有去模块（无 MCU 版本 DM1TA）例程配套测试的板子正常工作时，本例程会在串口上输出对应的测距信息
//      DM1RA distance data: ...
//      DM1RA distance data: ...
// 
// 如果发现现象与说明严重不符 请参照本文件最下方 例程常见问题说明 进行排查


// **************************** 代码区域 ****************************
#define LED1                        (H2 )

int main (void)
{
    clock_init(SYSTEM_CLOCK_120M);                                              // 初始化芯片时钟 工作频率为 120MHz
    debug_init();                                                               // 初始化默认 Debug UART

    // 此处编写用户代码 例如外设初始化代码等
    gpio_init(LED1, GPO, GPIO_HIGH, GPO_PUSH_PULL);                             // 初始化 LED1 输出 默认高电平 推挽输出模式

    while(1)
    {
        if(dm1xa_init())
        {
            printf("\r\nDM1RA init error.");                                     // DL1A 初始化失败
        }
        else
        {
            break;
        }
        gpio_toggle_level(LED1);                                                // 翻转 LED 引脚输出电平 控制 LED 亮灭 初始化出错这个灯会闪的很慢
    }
    // 此处编写用户代码 例如外设初始化代码等

    while(1)
    {
        // 此处编写需要循环执行的代码
        system_delay_ms(500);
        printf("\r\nDM1RA distance data: %5d", dm1xa_receiver_ranging());
        gpio_toggle_level(LED1);                                                // 翻转 LED 引脚输出电平 控制 LED 亮灭
        // 此处编写需要循环执行的代码
    }
}
// **************************** 代码区域 ****************************

// *************************** 例程常见问题说明 ***************************
// 遇到问题时请按照以下问题检查列表检查
// 
// 问题1：串口没有数据
//      查看串口助手打开的是否是正确的串口，检查打开的 COM 口是否对应的是调试下载器或者 USB-TTL 模块的 COM 口
//      如果是使用逐飞科技 CMSIS-DAP | ARM 调试下载器连接，那么检查下载器线是否松动，检查核心板串口跳线是否已经焊接，串口跳线查看核心板原理图即可找到
//      如果是使用 USB-TTL 模块连接，那么检查连线是否正常是否松动，模块 TX 是否连接的核心板的 RX，模块 RX 是否连接的核心板的 TX
// 
// 问题2：串口数据乱码
//      查看串口助手设置的波特率是否与程序设置一致，程序中 zf_common_debug.h 文件中 DEBUG_UART_BAUDRATE 宏定义为 debug uart 使用的串口波特率
// 
// 问题3：串口输出 DM1RA init error.
//      检查 DM1RA 的接线是否正确是否松动
//      检查 DM1RA 的模块是不是坏了
// 
// 问题4：DM1RA 数值异常 显示 6800
//      确认 DM1TA 板子接好并下载好程序在正常工作
//      把 DM1TA 和 DM1RA 模块对正 中间无遮挡
//      看看两个模块是否蓝灯亮起来 DM1TA 不亮蓝灯就去检查 DM1TA 如果 DM1RA 不亮蓝灯就联系客服