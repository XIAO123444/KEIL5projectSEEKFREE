/*********************************************************************************************************************
* MM32F327X-G8P Opensourec Library 即（MM32F327X-G8P 开源库）是一个基于官方 SDK 接口的第三方开源库
* Copyright (c) 2022 SEEKFREE 逐飞科技
* 
* 本文件是 MM32F327X-G8P 开源库的一部分
* 
* MM32F327X-G8P 开源库 是免费软件
* 您可以根据自由软件基金会发布的 GPL（GNU General Public License，即 GNU通用公共许可证）的条款
* 即 GPL 的第3版（即 GPL3.0）或（您选择的）任何后来的版本，重新发布和/或修改它
* 
* 本开源库的发布是希望它能发挥作用，但并未对其作任何的保证
* 甚至没有隐含的适销性或适合特定用途的保证
* 更多细节请参见 GPL
* 
* 您应该在收到本开源库的同时收到一份 GPL 的副本
* 如果没有，请参阅<https://www.gnu.org/licenses/>
* 
* 额外注明：
* 本开源库使用 GPL3.0 开源许可证协议 以上许可申明为译文版本
* 许可申明英文版在 libraries/doc 文件夹下的 GPL3_permission_statement.txt 文件中
* 许可证副本在 libraries 文件夹下 即该文件夹下的 LICENSE 文件
* 欢迎各位使用并传播本程序 但修改内容时必须保留逐飞科技的版权声明（即本声明）
* 
* 文件名称          main
* 公司名称          成都逐飞科技有限公司
* 版本信息          查看 libraries/doc 文件夹内 version 文件 版本说明
* 开发环境          IAR 8.32.4 or MDK 5.37
* 适用平台          MM32F327X_G8P
* 店铺链接          https://seekfree.taobao.com/
* 
* 修改记录
* 日期              作者                备注
* 2022-08-10        Teternal            first version
********************************************************************************************************************/

#include "zf_common_headfile.h"

// 打开新的工程或者工程移动了位置务必执行以下操作
// 第一步 关闭上面所有打开的文件
// 第二步 project->clean  等待下方进度条走完


// 本例程是 有去模块（无 MCU 版本 DM1TA） 的使用例程 本例程仅演示如何使用 DM1TA 进行测距信号发送 本例程不显示数据
// 本例程是 有去模块（无 MCU 版本 DM1TA） 的使用例程 本例程仅演示如何使用 DM1TA 进行测距信号发送 本例程不显示数据
// 本例程是 有去模块（无 MCU 版本 DM1TA） 的使用例程 本例程仅演示如何使用 DM1TA 进行测距信号发送 本例程不显示数据


// *************************** 例程硬件连接说明 ***************************
// 使用逐飞科技 CMSIS-DAP | ARM 调试下载器连接
//      直接将下载器正确连接在核心板的调试下载接口即可
// 
// 使用 USB-TTL 模块连接
//      模块管脚            单片机管脚
//      USB-TTL-RX          查看 zf_common_debug.h 文件中 DEBUG_UART_TX_PIN 宏定义的引脚 默认 B6
//      USB-TTL-TX          查看 zf_common_debug.h 文件中 DEBUG_UART_RX_PIN 宏定义的引脚 默认 B7
//      USB-TTL-GND         核心板电源地 GND
//      USB-TTL-3V3         核心板 3V3 电源
// 
// 接入 DM1TA 模块
//      模块管脚            单片机管脚
//      FB                  查看 zf_device_dm1xa.h 中 DM1XA_FB_PIN  宏定义 默认 B11
//      EN                  查看 zf_device_dm1xa.h 中 DM1XA_EN_PIN  宏定义 默认 B10
//      VCC                 5V 电源
//      GND                 电源地


// *************************** 例程测试说明 ***************************
// 1.核心板烧录完成本例程
// 
// 2.在断电情况下，单独使用核心板与调试下载器或者 USB-TTL 模块连接，并连接好 DM1TA 模块
//      ( 如果使用配套的学习主板测试，则直接将 DM1TA 模块接到对应的接口位置 )
// 
// 3.使用 Type-C 给核心板供电，将调试下载器或者 USB-TTL 模块连接到电脑
//      ( 如果使用配套的学习主板测试，则需要直接使用电池供电，2S锂电池/蓝电池电压不应低于7.8V，3S锂电池电压不应低于11.3V )
// 
// 4.DM1TA 模块上蓝灯会低亮度常亮（50Hz闪烁 短点亮时间 看起来就是低亮度常亮）
// 
// 如果发现现象与说明严重不符 请参照本文件最下方 例程常见问题说明 进行排查


// **************************** 代码区域 ****************************
#define LED1                        (H2 )

#define PIT                         (TIM6_PIT )                                 // 使用的周期中断编号 如果修改 需要同步对应修改周期中断编号与 isr.c 中的调用

uint16 pit_ms_count = 0;

int main (void)
{
    clock_init(SYSTEM_CLOCK_120M);                                              // 初始化芯片时钟 工作频率为 120MHz
    debug_init();                                                               // 初始化默认 Debug UART

    // 此处编写用户代码 例如外设初始化代码等
    gpio_init(LED1, GPO, GPIO_HIGH, GPO_PUSH_PULL);                             // 初始化 LED1 输出 默认高电平 推挽输出模式

    while(1)
    {
        if(dm1xa_init())
        {
            printf("\r\nDM1TA init error.");                                     // DL1A 初始化失败
        }
        else
        {
            break;
        }
        gpio_toggle_level(LED1);                                                // 翻转 LED 引脚输出电平 控制 LED 亮灭 初始化出错这个灯会闪的很慢
    }
    pit_ms_init(PIT, 5);
    // 此处编写用户代码 例如外设初始化代码等

    while(1)
    {
        // 此处编写需要循环执行的代码
        system_delay_ms(500);
        gpio_toggle_level(LED1);                                                // 翻转 LED 引脚输出电平 控制 LED 亮灭
        // 此处编写需要循环执行的代码
    }
}

//-------------------------------------------------------------------------------------------------------------------
// 函数简介     PIT 的中断处理函数 这个函数将在 PIT 对应的定时器中断调用 详见 isr.c
// 参数说明     void
// 返回参数     void
// 使用示例     pit_handler();
//-------------------------------------------------------------------------------------------------------------------
void pit_handler (void)
{
    if(0 == pit_ms_count % 20)                                                  // 每 20ms 发起一次测距
    {
        // 测距调用频率应在 50-100Hz 周期在 10-20ms
        // 测距调用频率应在 50-100Hz 周期在 10-20ms
        // 测距调用频率应在 50-100Hz 周期在 10-20ms
        dm1xa_transmitter_ranging();
    }
    pit_ms_count = (pit_ms_count == 995) ? (0) : (pit_ms_count + 5);            // 1000ms 周期计数
}
// **************************** 代码区域 ****************************

// *************************** 例程常见问题说明 ***************************
// 遇到问题时请按照以下问题检查列表检查
// 
// 问题1：串口输出 DM1TA init error.
//      检查 DM1TA 的接线是否正确是否松动
//      检查 DM1TA 的模块是不是坏了
// 
// 问题2：DM1TA 不亮灯或者蓝灯不亮
//      检查接线是否正确是否松动
//      不亮红灯检查供电是否正常，是否短路
